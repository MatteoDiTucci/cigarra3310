## conf/local.conf
```bitbake
include "application.conf"

db.default {
  # You can declare as many datasources as you want.
  # By convention, the default datasource is named `default`

  url = "jdbc:mysql://localhost/cigarra3310db?useUnicode=true&useJDBCCompliantTimezoneShift=true&useLegacyDatetimeCode=false&serverTimezone=UTC&useSSL=false"
  username = "cigarra"
  password = "cigarra"
  poolMaxSize=10
  host = "localhost"

  # You can turn on SQL logging for any datasource
  # https://www.playframework.com/documentation/latest/Highlights25#Logging-SQL-statements
  default.logSql=true
}
```
